#include <Wire.h>
#include <Adafruit GFX.h>
#include <Adafruit_SH1106.h>

#define SCREEN WIDTH 128

#define SCREEN HEIGHT 64

#define OLED RESET -1
Adafruit_SH1106 display(OLED_RESET);
int irin = 11;
int irout = 5;
int buzz = 10;
int maxc = 0;
int total = 0;
int incount =0;
int xx = 40;
int yy = 0;
int tt = 0;

const unsigned char caution [] PROGMEM = {
	// 'warning-sign-39220, 128x32px
	0xff, 0xff, 0xff, 0xff, 0xff, 0xff, 0xff, 0xfc, 0x3f, 0xff, 0xff, 0xff, 0xff, 0xff, 0xff, 0xff, 
	0xff, 0xff, 0xff, 0xff, 0xff, 0xff, 0xff, 0xf8, 0x1f, 0xff, 0xff, 0xff, 0xff, 0xff, 0xff, 0xff, 
	0xff, 0xff, 0xff, 0xff, 0xff, 0xff, 0xff, 0xf1, 0x8f, 0xff, 0xff, 0xff, 0xff, 0xff, 0xff, 0xff, 
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	0xff, 0xff, 0xff, 0xff, 0xff, 0xff, 0x00, 0x00, 0x00, 0x00, 0xff, 0xff, 0xff, 0xff, 0xff, 0xff
};

void setup(){
	Serial.begin(9600);
	display.begin(SH1106_SWITCHCAPVCC, 0x3C);
	delay(2000);
	pinMode(irin, INPUT);
	pinMode(irout, INPUT);
	pinMode(buzz, OUTPUT);
	display.clearDisplay();
	display.setTextSize(2);
 	display.setTextColor(WHITE); 
	display.setCursor(20, 20);
	display.print("Visitor");
	display.setCursor(20, 40);
	display.print("Counter");
	display.display(); 
	delay(3000);
}


﻿
void loop() {
	int in = digitalRead(irin); 
	int out = digitalRead(irout); 
	if (in==LOW && out == HIGH) {
		while (out==HIGH) {
			out = digitalRead(irout);
	}
	digitalWrite(buzz, HIGH);
	delay(100);
	delay(100);
	digitalWrite(buzz, LOW);
	total++;
	maxc++;
	incount++;
	delay(100);
	display.clearDisplay(); 
	display.setTextColor(WHITE);
	display.setTextSize(1);
	display.setCursor(15, 0);
	display.print("Current Visitor"); 
	display.setTextSize(2);
	display.setCursor(50, 15);
	display.print(incount);
	Serial.println("IN:");
	Serial.println(incount);
	display.setTextSize(1);
	display.setCursor(0, 40);
	display.setTextSize(2);
	display.print("TOTAL: ");
	display.print(total);
	display.display();
	delay(500);

	if (out==LOW && in ==HIGH && incount > 0) {
		while (in==HIGH) {
			in = digitalRead(irin);
		}
		incount--;
		digitalWrite(buzz, HIGH);
		delay(100);
		digitalWrite(buzz, LOW);
		delay(100);
		display.clearDisplay();
		display.setTextColor(WHITE);
		display.setTextSize(1); 
		display.setCursor(15, 0);
		display.print("Current Visitor"); 
		display.setTextSize(2);
		display.setCursor(50, 15);
		display.print(incount);
		display.setTextSize(1);
		display.setCursor(0, 40);
		display.setTextSize(2);
		display.print("TOTAL: ");
		display.print(total);
		display.display();
		delay(500);
	}

﻿	if (incount <= 0) {
		display.clearDisplay();
		display.setTextSize(2);
		display.setTextColor(WHITE); 
		display.setCursor(0, 15); 
		display.print("No Visitor"); 
		display.display(); 
		delay(500);
	}
	if (maxc >= 5) {
		display.clearDisplay();
		display.drawBitmap(xx, yy, caution, 48, 48, 1);
		display.display();
		delay(2000);
		display.clearDisplay();
		display.setTextSize(2);
		display.setTextColor(WHITE);
		display.setCursor(0, 15);
		display.print("MAX!");
		display.display(); 
		delay(3000);
		maxc = 0;
		incount=0;
	}
}
